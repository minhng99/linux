## Documentation/devicetree/bindings/power/realtek,rtd1296-nat-sram-power.yaml
```yaml
# SPDX-License-Identifier: (GPL-2.0-only OR BSD-2-Clause)
%YAML 1.2
---
$id: http://devicetree.org/schemas/power/realtek,rtd1296-nat-sram-power.yaml#
$schema: http://devicetree.org/meta-schemas/core.yaml#

title: Realtek RTD1296 Ethernet switch SRAM power controller

maintainers:
  - Nguyen Quang Minh <oss@minhng99.eu>

description: |
  The controller manages SRAM power and isolation for the Ethernet switch.
  It is a child of the CRT system controller.

properties:
  compatible:
    const: realtek,rtd1296-nat-sram-power

  "#power-domain-cells":
    const: 0

required:
  - compatible
  - "#power-domain-cells"

additionalProperties: false
```

## Documentation/devicetree/bindings/power/realtek,rtd1296-tve-analog-power.yaml
```yaml
# SPDX-License-Identifier: (GPL-2.0-only OR BSD-2-Clause)
%YAML 1.2
---
$id: http://devicetree.org/schemas/power/realtek,rtd1296-tve-analog-power.yaml#
$schema: http://devicetree.org/meta-schemas/core.yaml#

title: Realtek RTD1296 TVE analogue power controller

maintainers:
  - Nguyen Quang Minh <oss@minhng99.eu>

description: |
  The microphone ADC requires the TVE analogue enable.
  The controller is a child of the TVE system controller.

properties:
  compatible:
    const: realtek,rtd1296-tve-analog-power

  reg:
    maxItems: 1

  clocks:
    maxItems: 1

  resets:
    items:
      - description: Shared TVE reset
      - description: Shared display-domain reset

  reset-names:
    items:
      - const: tve
      - const: domain

  '#power-domain-cells':
    const: 0

required:
  - compatible
  - reg
  - clocks
  - resets
  - reset-names
  - '#power-domain-cells'

additionalProperties: false
```

## Documentation/devicetree/bindings/regulator/gmt,g2227.yaml
```yaml
# SPDX-License-Identifier: (GPL-2.0-only OR BSD-2-Clause)
%YAML 1.2
---
$id: http://devicetree.org/schemas/regulator/gmt,g2227.yaml#
$schema: http://devicetree.org/meta-schemas/core.yaml#

title: GMT G2227 power-management controller

maintainers:
  - Nguyen Quang Minh <oss@minhng99.eu>

description:
  The G2227 provides six buck converters and two LDO regulators, with
  software power-off control through its I2C interface.

properties:
  compatible:
    const: gmt,g2227

  reg:
    maxItems: 1

  system-power-controller: true

  regulators:
    type: object
    additionalProperties: false
    patternProperties:
      '^(dcdc[1-6]|ldo[23])$':
        type: object
        $ref: regulator.yaml#
        unevaluatedProperties: false

required:
  - compatible
  - reg
  - regulators

additionalProperties: false

examples:
  - |
    i2c {
        #address-cells = <1>;
        #size-cells = <0>;

        pmic@12 {
            compatible = "gmt,g2227";
            reg = <0x12>;
            system-power-controller;

            regulators {
                dcdc2 {
                    regulator-name = "vdd-cpu";
                    regulator-min-microvolt = <800000>;
                    regulator-max-microvolt = <1187500>;
                    regulator-always-on;
                };
            };
        };
    };
```

## Documentation/devicetree/bindings/rtc/realtek,rtd1295-rtc.yaml
```yaml
# SPDX-License-Identifier: (GPL-2.0-only OR BSD-2-Clause)
%YAML 1.2
---
$id: http://devicetree.org/schemas/rtc/realtek,rtd1295-rtc.yaml#
$schema: http://devicetree.org/meta-schemas/core.yaml#

title: Realtek RTD129x real-time clock

maintainers:
  - Nguyen Quang Minh <oss@minhng99.eu>

allOf:
  - $ref: rtc.yaml#
  - if:
      required:
        - interrupts
    then:
      required:
        - realtek,iso-syscon

properties:
  compatible:
    const: realtek,rtd1295-rtc

  reg:
    maxItems: 1

  clocks:
    maxItems: 1

  interrupts:
    maxItems: 1

  realtek,iso-syscon:
    $ref: /schemas/types.yaml#/definitions/phandle
    description: Isolation controller containing alarm enable and status registers.

  wakeup-source: true

required:
  - compatible
  - reg
  - clocks

unevaluatedProperties: false

examples:
  - |
    rtc@9801b600 {
        compatible = "realtek,rtd1295-rtc";
        reg = <0x9801b600 0x34>;
        clocks = <&rtc_clk>;
        interrupt-parent = <&iso_irq_mux>;
        interrupts = <13>;
        realtek,iso-syscon = <&iso>;
        wakeup-source;
    };
```

## Documentation/devicetree/bindings/sound/realtek,rtd1296-aio.yaml
```yaml
# SPDX-License-Identifier: (GPL-2.0-only OR BSD-2-Clause)
%YAML 1.2
---
$id: http://devicetree.org/schemas/sound/realtek,rtd1296-aio.yaml#
$schema: http://devicetree.org/meta-schemas/core.yaml#

title: Realtek RTD1296 audio input controller

maintainers:
  - Nguyen Quang Minh <oss@minhng99.eu>

description: |
  The controller contains an integrated stereo microphone ADC and input DMA.
  DAI 0 provides CPU DMA and DAI 1 provides the microphone ADC.

allOf:
  - $ref: dai-common.yaml#

properties:
  compatible:
    const: realtek,rtd1296-aio

  reg:
    maxItems: 1

  interrupts:
    maxItems: 1

  clocks:
    maxItems: 7

  clock-names:
    items:
      - const: bus
      - const: codec
      - const: mod
      - const: da
      - const: i2s
      - const: mclk
      - const: pcm

  resets:
    maxItems: 1

  reset-names:
    items:
      - const: aio

  power-domains:
    maxItems: 1

  '#sound-dai-cells':
    const: 1

required:
  - compatible
  - reg
  - interrupts
  - clocks
  - clock-names
  - resets
  - reset-names
  - power-domains
  - '#sound-dai-cells'

unevaluatedProperties: false
```

## Documentation/devicetree/bindings/spi/realtek,rtd1296-sfc.yaml
```yaml
# SPDX-License-Identifier: (GPL-2.0-only OR BSD-2-Clause)
%YAML 1.2
---
$id: http://devicetree.org/schemas/spi/realtek,rtd1296-sfc.yaml#
$schema: http://devicetree.org/meta-schemas/core.yaml#

title: Realtek RTD1296 serial flash controller

maintainers:
  - Nguyen Quang Minh <oss@minhng99.eu>

description:
  The controller issues flash commands through accesses to a CPU aperture.
  SB2 provides the posted-write flush between configuration and aperture
  accesses. The serial clock divides the SB2 bus clock. The boot firmware supplies
  the initial pad timing.

allOf:
  - $ref: spi-controller.yaml#

properties:
  compatible:
    const: realtek,rtd1296-sfc

  reg:
    items:
      - description: Command and timing registers
      - description: Flash access aperture

  reg-names:
    items:
      - const: ctrl
      - const: flash

  clocks:
    items:
      - description: SB2 bus clock

  realtek,sb2:
    $ref: /schemas/types.yaml#/definitions/phandle
    description: SB2 system controller

required:
  - compatible
  - reg
  - reg-names
  - realtek,sb2
  - clocks

unevaluatedProperties: false

examples:
  - |
    #include <dt-bindings/clock/realtek,rtd1296-clk.h>

    spi@9801a800 {
        compatible = "realtek,rtd1296-sfc";
        reg = <0x9801a800 0x30>, <0x88100000 0x1000000>;
        reg-names = "ctrl", "flash";
        clocks = <&crt_clk RTD1296_CRT_CLK_SYS_SB2>;
        realtek,sb2 = <&sb2>;
        #address-cells = <1>;
        #size-cells = <0>;

        flash@0 {
            compatible = "jedec,spi-nor";
            reg = <0>;
            spi-max-frequency = <25000000>;
        };
    };
```

## Documentation/devicetree/bindings/thermal/realtek,rtd1296-thermal.yaml
```yaml
# SPDX-License-Identifier: (GPL-2.0-only OR BSD-2-Clause)
%YAML 1.2
---
$id: http://devicetree.org/schemas/thermal/realtek,rtd1296-thermal.yaml#
$schema: http://devicetree.org/meta-schemas/core.yaml#

title: Realtek RTD1296 thermal sensor

maintainers:
  - Nguyen Quang Minh <oss@minhng99.eu>

allOf:
  - $ref: thermal-sensor.yaml#

properties:
  compatible:
    const: realtek,rtd1296-thermal

  reg:
    maxItems: 1

  '#thermal-sensor-cells':
    const: 0

required:
  - compatible
  - reg

unevaluatedProperties: false

examples:
  - |
    thermal-sensor@9801d150 {
        compatible = "realtek,rtd1296-thermal";
        reg = <0x9801d150 0x20>;
        #thermal-sensor-cells = <0>;
    };
```

## Documentation/devicetree/bindings/usb/realtek,rtd1296-usb-bus.yaml
```yaml
# SPDX-License-Identifier: (GPL-2.0-only OR BSD-2-Clause)
%YAML 1.2
---
$id: http://devicetree.org/schemas/usb/realtek,rtd1296-usb-bus.yaml#
$schema: http://devicetree.org/meta-schemas/core.yaml#

title: Realtek RTD1296 USB clock and reset interface

maintainers:
  - Nguyen Quang Minh <oss@minhng99.eu>

properties:
  compatible:
    const: realtek,rtd1296-usb-bus

  reg:
    maxItems: 1
    description: Shared USB2 wrapper registers.

  clocks:
    maxItems: 1

  resets:
    minItems: 10
    maxItems: 10

  reset-names:
    items:
      - const: serdes
      - const: usb2-0
      - const: usb2-1
      - const: usb2-2
      - const: usb3-0
      - const: usb2-3
      - const: usb3-1
      - const: controller
      - const: mdio0
      - const: mdio1

  usb2-vbus-supply:
    description: VBUS supply for the port shared by EHCI and OHCI.

  '#address-cells':
    const: 1

  '#size-cells':
    const: 1

  ranges: true

patternProperties:
  "^(usb|phy|type-c)@[0-9a-f]+$":
    type: object
    additionalProperties: true

required:
  - compatible
  - reg
  - clocks
  - resets
  - reset-names
  - '#address-cells'
  - '#size-cells'
  - ranges

additionalProperties: false
```

## drivers/clk/realtek/Kconfig
```kconfig
# SPDX-License-Identifier: GPL-2.0-only

config COMMON_CLK_RTD1296
	bool "Clock driver for Realtek RTD1296"
	depends on ARCH_REALTEK || COMPILE_TEST
	select MFD_SYSCON
	help
	  Support for the CRT and ISO clock controllers of the Realtek
	  RTD1296 SoC. They provide the PLLs and the
	  clock gates of the on-chip peripherals.

	  Say Y if you want to run Linux on this SoC.
```

## drivers/gpu/drm/realtek/Kconfig
```kconfig
# SPDX-License-Identifier: GPL-2.0-only
config DRM_RTD1296
	tristate "Realtek RTD1296 display controller"
	depends on DRM && OF && COMMON_CLK
	depends on ARCH_REALTEK || COMPILE_TEST
	depends on I2C
	depends on PM && GPIOLIB && RESET_CONTROLLER
	select DRM_CLIENT_SELECTION
	select DRM_GEM_DMA_HELPER
	select DRM_KMS_HELPER
	select DRM_DISPLAY_HELPER
	select DRM_DISPLAY_DP_HELPER
	select MFD_SYSCON
	help
	  Support the video output controller and its HDMI and DisplayPort
	  transmitters. The driver provides an atomic KMS display pipeline,
	  linear RGB scanout buffers, hotplug detection and EDID access.
	  Output clocks and resets follow runtime power management.
```
