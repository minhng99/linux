## Documentation/devicetree/bindings/clock/realtek,rtd1296-clk.yaml
```yaml
# SPDX-License-Identifier: (GPL-2.0-only OR BSD-2-Clause)
%YAML 1.2
---
$id: http://devicetree.org/schemas/clock/realtek,rtd1296-clk.yaml#
$schema: http://devicetree.org/meta-schemas/core.yaml#

title: Realtek RTD1296 clock controllers

maintainers:
  - Nguyen Quang Minh <oss@minhng99.eu>

description: |
  The RTD1296 SoC has clock controls spread over
  two system controller blocks:

  - The CRT block holds the PLLs, the system bus and CPU clock selection and
    the clock enable registers of most peripherals.
  - The ISO block, which stays powered in standby, holds the clock enable
    register of the peripherals in the always-on domain.

  Each clock controller is described as a child node of the corresponding
  system controller (see realtek,rtd1xxx.yaml) and accesses its registers
  through the parent.

  The clock model feeds all PLLs from the 27 MHz oscillator.
  Most gates in the CRT block are modelled as
  children of the system bus clock, except for the GPU gate, which is fed by
  the GPU PLL, and the MISC I2C gates, which are fed by the 27 MHz
  oscillator. Gates in the ISO block are modelled as children of the 27 MHz
  oscillator.

  The AIO PCM clock provides the 48 kHz capture profile.
  Audio signal gates expose enable controls without a rate parent.
  The AIO bus gate follows the system bus clock.

  See include/dt-bindings/clock/realtek,rtd1296-clk.h for the clock indices.

properties:
  compatible:
    enum:
      - realtek,rtd1296-crt-clk
      - realtek,rtd1296-iso-clk

  clocks:
    items:
      - description: 27 MHz oscillator

  '#clock-cells':
    const: 1

required:
  - compatible
  - clocks
  - '#clock-cells'

additionalProperties: false

examples:
  - |
    clock-controller {
        compatible = "realtek,rtd1296-crt-clk";
        clocks = <&osc27M>;
        #clock-cells = <1>;
    };
```

## Documentation/devicetree/bindings/display/realtek,rtd1296-display.yaml
```yaml
# SPDX-License-Identifier: (GPL-2.0-only OR BSD-2-Clause)
%YAML 1.2
---
$id: http://devicetree.org/schemas/display/realtek,rtd1296-display.yaml#
$schema: http://devicetree.org/meta-schemas/core.yaml#

title: Realtek RTD1296 display controller

maintainers:
  - Nguyen Quang Minh <oss@minhng99.eu>

description:
  The video output controller feeds the HDMI and DisplayPort transmitters.
  The transmitters share display clock routing and reset controls.

properties:
  compatible:
    const: realtek,rtd1296-display

  reg:
    items:
      - description: Video output controller
      - description: HDMI transmitter
      - description: DisplayPort analogue interface and timing generator
      - description: DisplayPort transmitter

  reg-names:
    items:
      - const: vo
      - const: hdmi
      - const: lvds
      - const: dp

  interrupts:
    items:
      - description: HDMI transmitter interrupt
      - description: DisplayPort timing generator interrupt

  interrupt-names:
    items:
      - const: hdmi
      - const: pif

  clocks:
    maxItems: 4

  clock-names:
    items:
      - const: vo
      - const: hdmi
      - const: tve
      - const: lvds

  resets:
    maxItems: 6

  reset-names:
    items:
      - const: vo
      - const: hdmi
      - const: lvds
      - const: dp
      - const: domain
      - const: tve

  realtek,crt:
    $ref: /schemas/types.yaml#/definitions/phandle
    description: CRT system controller

  ddc-i2c-bus:
    $ref: /schemas/types.yaml#/definitions/phandle
    description: HDMI DDC controller

  hdmi-hpd-gpios:
    maxItems: 1
    description: HDMI hotplug input

  dp-hpd-gpios:
    maxItems: 1
    description: DisplayPort hotplug input

required:
  - compatible
  - reg
  - reg-names
  - interrupts
  - interrupt-names
  - clocks
  - clock-names
  - resets
  - reset-names
  - realtek,crt
  - ddc-i2c-bus
  - hdmi-hpd-gpios
  - dp-hpd-gpios

additionalProperties: false
```

## Documentation/devicetree/bindings/interrupt-controller/realtek,rtd1296-irq-mux.yaml
```yaml
# SPDX-License-Identifier: (GPL-2.0-only OR BSD-2-Clause)
%YAML 1.2
---
$id: http://devicetree.org/schemas/interrupt-controller/realtek,rtd1296-irq-mux.yaml#
$schema: http://devicetree.org/meta-schemas/core.yaml#

title: Realtek RTD1296 MISC and ISO interrupt muxes

maintainers:
  - Nguyen Quang Minh <oss@minhng99.eu>

description:
  The low-speed peripherals of the RTD1296 MISC and ISO blocks share a status
  and enable register per block.
  The ISO block can route its RTC alarm through a dedicated parent interrupt.
  The single interrupt specifier cell is the source bit in the status register.

properties:
  compatible:
    enum:
      - realtek,rtd1296-misc-irq-mux
      - realtek,rtd1296-iso-irq-mux

  reg:
    items:
      - description: Interrupt status register
      - description: Interrupt enable register

  interrupts:
    minItems: 1
    items:
      - description: Peripheral aggregate interrupt
      - description: Dedicated RTC alarm interrupt

  interrupt-names:
    minItems: 1
    items:
      - const: peripherals
      - const: rtc-alarm

  interrupt-controller: true

  '#interrupt-cells':
    const: 1

required:
  - compatible
  - reg
  - interrupts
  - interrupt-controller
  - '#interrupt-cells'

additionalProperties: false

allOf:
  - if:
      properties:
        compatible:
          const: realtek,rtd1296-misc-irq-mux
    then:
      properties:
        interrupts:
          maxItems: 1
        interrupt-names:
          maxItems: 1

examples:
  - |
    #include <dt-bindings/interrupt-controller/arm-gic.h>

    interrupt-controller@0 {
        compatible = "realtek,rtd1296-iso-irq-mux";
        reg = <0x0 0x4>, <0x40 0x4>;
        interrupts = <GIC_SPI 41 IRQ_TYPE_LEVEL_HIGH>;
        interrupt-controller;
        #interrupt-cells = <1>;
    };
  - |
    #include <dt-bindings/interrupt-controller/arm-gic.h>

    interrupt-controller@0 {
        compatible = "realtek,rtd1296-iso-irq-mux";
        reg = <0x0 0x4>, <0x40 0x4>;
        interrupts = <GIC_SPI 41 IRQ_TYPE_LEVEL_HIGH>,
                     <GIC_SPI 39 IRQ_TYPE_LEVEL_HIGH>;
        interrupt-names = "peripherals", "rtc-alarm";
        interrupt-controller;
        #interrupt-cells = <1>;
    };
```

## Documentation/devicetree/bindings/media/realtek,rtd1296-hdmirx.yaml
```yaml
# SPDX-License-Identifier: (GPL-2.0-only OR BSD-2-Clause)
%YAML 1.2
---
$id: http://devicetree.org/schemas/media/realtek,rtd1296-hdmirx.yaml#
$schema: http://devicetree.org/meta-schemas/core.yaml#

title: Realtek RTD1296 HDMI receiver

maintainers:
  - Nguyen Quang Minh <oss@minhng99.eu>

description:
  The HDMI receiver includes a TMDS decoder, equalizer and video PLL.
  A wrapper feeds decoded video to a two-slot memory capture engine.
  The DDC responder provides EDID storage for the input connector.

properties:
  compatible:
    const: realtek,rtd1296-hdmirx

  reg:
    items:
      - description: Receiver, PHY and equalizer
      - description: Video wrapper
      - description: DDC responder
      - description: Memory capture engine
      - description: CBUS physical interface and source detection

  reg-names:
    items:
      - const: rx
      - const: wrapper
      - const: ddc
      - const: capture
      - const: cbus

  interrupts:
    maxItems: 1

  clocks:
    items:
      - description: Receiver bus clock
      - description: Capture bus clock
      - description: Shared VO clock
      - description: CBUS oscillator clock
      - description: CBUS system clock
      - description: CBUS transmitter clock
      - description: CBUS receiver clock

  clock-names:
    items:
      - const: rx
      - const: capture
      - const: vo
      - const: cbus-osc
      - const: cbus
      - const: cbus-tx
      - const: cbus-rx

  resets:
    items:
      - description: Receiver reset
      - description: Input wrapper reset
      - description: Capture engine reset
      - description: CBUS controller reset
      - description: CBUS transmitter reset
      - description: CBUS receiver reset
      - description: Shared display reset

  reset-names:
    items:
      - const: rx
      - const: wrapper
      - const: capture
      - const: cbus
      - const: cbus-tx
      - const: cbus-rx
      - const: domain

  hpd-gpios:
    maxItems: 1
    description: Hotplug output asserted after EDID becomes available

required:
  - compatible
  - reg
  - reg-names
  - interrupts
  - clocks
  - clock-names
  - resets
  - reset-names
  - hpd-gpios

additionalProperties: false
```

## Documentation/devicetree/bindings/mfd/realtek,rtd1xxx.yaml
```yaml
# SPDX-License-Identifier: GPL-2.0-only OR BSD-2-Clause
%YAML 1.2
---
$id: http://devicetree.org/schemas/mfd/realtek,rtd1xxx.yaml#
$schema: http://devicetree.org/meta-schemas/core.yaml#

title: Realtek RTD1xxx system controllers

maintainers:
  - Andreas Färber <afaerber@suse.de>

properties:
  compatible:
    items:
      - enum:
          - realtek,rtd1293-crt
          - realtek,rtd1293-iso
          - realtek,rtd1293-misc
          - realtek,rtd1293-sb2
          - realtek,rtd1293-scpu-wrapper
          - realtek,rtd1295-crt
          - realtek,rtd1295-iso
          - realtek,rtd1295-misc
          - realtek,rtd1295-sb2
          - realtek,rtd1295-scpu-wrapper
          - realtek,rtd1296-crt
          - realtek,rtd1296-iso
          - realtek,rtd1296-misc
          - realtek,rtd1296-sb2
          - realtek,rtd1296-scpu-wrapper
          - realtek,rtd1395-crt
          - realtek,rtd1395-iso
          - realtek,rtd1395-misc
          - realtek,rtd1395-sb2
          - realtek,rtd1395-scpu-wrapper
          - realtek,rtd1619-crt
          - realtek,rtd1619-iso
          - realtek,rtd1619-misc
          - realtek,rtd1619-sb2
          - realtek,rtd1619-scpu-wrapper
      - const: syscon
      - const: simple-mfd

  reg:
    maxItems: 1

  reg-io-width:
    const: 4

  ranges: true

  '#address-cells':
    const: 1

  '#size-cells':
    const: 1

  clock-controller:
    $ref: /schemas/clock/realtek,rtd1296-clk.yaml#
    type: object

  power-controller:
    $ref: /schemas/power/realtek,rtd1296-nat-sram-power.yaml#
    type: object

patternProperties:
  '@[0-9a-f]+$':
    type: object

    required:
      - compatible

required:
  - compatible
  - reg

allOf:
  - if:
      properties:
        compatible:
          contains:
            enum:
              - realtek,rtd1296-crt
    then:
      properties:
        clock-controller:
          properties:
            compatible:
              const: realtek,rtd1296-crt-clk
    else:
      if:
        properties:
          compatible:
            contains:
              enum:
                - realtek,rtd1296-iso
      then:
        properties:
          clock-controller:
            properties:
              compatible:
                const: realtek,rtd1296-iso-clk
      else:
        properties:
          clock-controller: false

  - if:
      not:
        properties:
          compatible:
            contains:
              const: realtek,rtd1296-crt
    then:
      properties:
        power-controller: false

additionalProperties: false
```

## Documentation/devicetree/bindings/mmc/realtek,rtd1296-dw-mshc.yaml
```yaml
# SPDX-License-Identifier: (GPL-2.0-only OR BSD-2-Clause)
%YAML 1.2
---
$id: http://devicetree.org/schemas/mmc/realtek,rtd1296-dw-mshc.yaml#
$schema: http://devicetree.org/meta-schemas/core.yaml#

title: Realtek RTD1296 eMMC controller

maintainers:
  - Nguyen Quang Minh <oss@minhng99.eu>

allOf:
  - $ref: mmc-controller.yaml#

properties:
  compatible:
    const: realtek,rtd1296-dw-mshc

  reg:
    maxItems: 1

  interrupts:
    maxItems: 1

  clocks:
    items:
      - description: Card-interface input clock
      - description: Shared card-reader register clock
      - description: eMMC card clock gate
      - description: Output phase clock
      - description: Input phase clock

  clock-names:
    items:
      - const: ciu
      - const: biu
      - const: card
      - const: ciu-drive
      - const: ciu-sample

  resets:
    items:
      - description: eMMC controller reset
      - description: Shared card-reader reset

  reset-names:
    items:
      - const: reset
      - const: cr

  fifo-depth:
    const: 256

  clk-phase-legacy: true

  non-removable: true

  no-sd: true

  no-sdio: true

required:
  - compatible
  - reg
  - interrupts
  - clocks
  - clock-names
  - resets
  - reset-names
  - clk-phase-legacy
  - non-removable
  - no-sd
  - no-sdio

unevaluatedProperties: false

examples:
  - |
    #include <dt-bindings/interrupt-controller/arm-gic.h>

    mmc@98012000 {
        compatible = "realtek,rtd1296-dw-mshc";
        reg = <0x98012000 0x600>;
        interrupts = <GIC_SPI 42 IRQ_TYPE_LEVEL_HIGH>;
        clocks = <&clocks 0>, <&clocks 1>, <&clocks 2>,
                 <&clocks 3>, <&clocks 4>;
        clock-names = "ciu", "biu", "card", "ciu-drive", "ciu-sample";
        resets = <&resets 11>, <&resets 10>;
        reset-names = "reset", "cr";
        bus-width = <8>;
        max-frequency = <25000000>;
        clk-phase-legacy = <0 180>;
        non-removable;
        no-sd;
        no-sdio;
    };
```

## Documentation/devicetree/bindings/mmc/realtek,rtd1296-sdmmc.yaml
```yaml
# SPDX-License-Identifier: (GPL-2.0-only OR BSD-2-Clause)
%YAML 1.2
---
$id: http://devicetree.org/schemas/mmc/realtek,rtd1296-sdmmc.yaml#
$schema: http://devicetree.org/meta-schemas/core.yaml#

title: Realtek RTD1296 SD card controller

maintainers:
  - Nguyen Quang Minh <oss@minhng99.eu>

allOf:
  - $ref: mmc-controller.yaml#

properties:
  compatible:
    const: realtek,rtd1296-sdmmc

  reg:
    maxItems: 1

  interrupts:
    maxItems: 1

  clocks:
    maxItems: 2

  clock-names:
    items:
      - const: biu
      - const: ciu

  resets:
    maxItems: 1

  realtek,sb2:
    $ref: /schemas/types.yaml#/definitions/phandle
    description: System bridge register block for transaction synchronization.

  bus-width:
    enum: [1, 4]

  vmmc-supply: true

required:
  - compatible
  - reg
  - interrupts
  - clocks
  - clock-names
  - resets
  - realtek,sb2
  - vmmc-supply

unevaluatedProperties: false

examples:
  - |
    #include <dt-bindings/clock/realtek,rtd1296-clk.h>
    #include <dt-bindings/interrupt-controller/arm-gic.h>
    #include <dt-bindings/reset/realtek,rtd1295.h>

    mmc@98010400 {
        compatible = "realtek,rtd1296-sdmmc";
        reg = <0x98010400 0x200>;
        interrupts = <GIC_SPI 44 IRQ_TYPE_LEVEL_HIGH>;
        clocks = <&crt_clk RTD1296_CRT_CLK_EN_CR>,
                 <&crt_clk RTD1296_CRT_CLK_EN_SD_IP>;
        clock-names = "biu", "ciu";
        resets = <&reset2 RTD1295_RSTN_CR>;
        realtek,sb2 = <&sb2>;
        vmmc-supply = <&sd_supply>;
        bus-width = <4>;
        max-frequency = <25000000>;
        no-1-8-v;
    };
```

## Documentation/devicetree/bindings/net/realtek,rtd1296-ethernet.yaml
```yaml
# SPDX-License-Identifier: (GPL-2.0-only OR BSD-2-Clause)
%YAML 1.2
---
$id: http://devicetree.org/schemas/net/realtek,rtd1296-ethernet.yaml#
$schema: http://devicetree.org/meta-schemas/core.yaml#

title: Realtek RTD1296 switch Ethernet controller

maintainers:
  - Nguyen Quang Minh <oss@minhng99.eu>

description: |
  The controller combines the switch CPU DMA interface and RGMII0 MAC.

allOf:
  - $ref: ethernet-controller.yaml#

properties:
  compatible:
    const: realtek,rtd1296-ethernet

  reg:
    maxItems: 1

  interrupts:
    maxItems: 1

  clocks:
    maxItems: 2

  clock-names:
    items:
      - const: bus
      - const: core

  resets:
    maxItems: 1

  power-domains:
    maxItems: 1

  phy-mode:
    enum: [rgmii, rgmii-id, rgmii-rxid, rgmii-txid]

  mdio:
    $ref: mdio.yaml#
    unevaluatedProperties: false

required:
  - compatible
  - reg
  - interrupts
  - clocks
  - clock-names
  - resets
  - power-domains
  - phy-mode
  - phy-handle
  - mdio

unevaluatedProperties: false
```
