## drivers/media/platform/realtek/Kconfig
```kconfig
# SPDX-License-Identifier: GPL-2.0-only
config VIDEO_RTD1296_HDMIRX
	tristate "Realtek RTD1296 HDMI receiver"
	depends on ARCH_REALTEK || COMPILE_TEST
	depends on V4L_PLATFORM_DRIVERS && VIDEO_DEV
	depends on OF && COMMON_CLK && RESET_CONTROLLER && PM
	depends on HAS_DMA && GPIOLIB
	select VIDEOBUF2_DMA_CONTIG
	help
	  HDMI video capture through the RTD1296 receiver and capture engine.
	  The receiver uses the V4L2 EDID and digital video timing interfaces.
	  Buffers use the contiguous DMA allocator.
	  The module is called rtd1296-hdmirx-driver.
```

## drivers/phy/realtek/Kconfig
```kconfig
# SPDX-License-Identifier: GPL-2.0
#
# Phy drivers for Realtek platforms
#

if ARCH_REALTEK || COMPILE_TEST

config PHY_RTD1296_SATA
	tristate "Realtek RTD1296 SATA PHY"
	depends on OF && HAS_IOMEM && COMMON_CLK && RESET_CONTROLLER
	select GENERIC_PHY
	select MFD_SYSCON
	help
	  Configure the two SATA PHYs and their generation-specific parameters
	  on RTD1296 through the shared MDIO interface.

	  To compile this driver as a module, choose M here: the
	  module will be called phy-rtd1296-sata.

config PHY_RTK_RTD_USB2PHY
	tristate "Realtek RTD USB2 PHY Transceiver Driver"
	depends on USB_SUPPORT
	select GENERIC_PHY
	select USB_PHY
	select USB_COMMON
	help
	  Enable this to support Realtek SoC USB2 phy transceiver.
	  The DHC (digital home center) RTD series SoCs used the Synopsys
	  DWC3 USB IP. This driver will do the PHY initialization
	  of the parameters.

config PHY_RTK_RTD_USB3PHY
	tristate "Realtek RTD USB3 PHY Transceiver Driver"
	depends on USB_SUPPORT
	select GENERIC_PHY
	select USB_PHY
	select USB_COMMON
	help
	  Enable this to support Realtek SoC USB3 phy transceiver.
	  The DHC (digital home center) RTD series SoCs used the Synopsys
	  DWC3 USB IP. This driver will do the PHY initialization
	  of the parameters.

endif # ARCH_REALTEK || COMPILE_TEST
```

## drivers/pmdomain/realtek/Kconfig
```kconfig
# SPDX-License-Identifier: GPL-2.0-only
config REALTEK_RTD1296_GPU_POWER
	bool "Realtek RTD1296 GPU power domain"
	depends on (ARCH_REALTEK || COMPILE_TEST) && OF && PM
	depends on COMMON_CLK && RESET_CONTROLLER
	select MFD_SYSCON
	select PM_GENERIC_DOMAINS
	help
	  Control the GPU SRAM and memory-repair interface.
	  Sequence its clock and reset around power transitions.
	  Poll SRAM and repair completion before exposing the device.
	  Runtime PM powers down SRAM when the consumer becomes idle.

config REALTEK_RTD1296_TVE_POWER
	bool "Realtek RTD1296 TVE analogue power domain"
	depends on (ARCH_REALTEK || COMPILE_TEST) && OF && PM
	depends on COMMON_CLK && RESET_CONTROLLER
	select MFD_SYSCON
	select PM_GENERIC_DOMAINS
	help
	  Control the TVE analogue block used by the microphone ADC.
	  The provider manages the shared resets and analogue enable.
	  Its register clock is enabled only during control accesses.
	  Consumers use runtime PM to request the power domain.

config REALTEK_RTD1296_NAT_POWER
	bool "Realtek RTD1296 Ethernet switch SRAM power domain"
	depends on (ARCH_REALTEK || COMPILE_TEST) && OF && PM
	select MFD_SYSCON
	select PM_GENERIC_DOMAINS
	help
	  Control isolation and SRAM power for the RTD1296 Ethernet switch.
	  Consumers manage their own clocks and logic resets.
	  Power transitions wait for the SRAM controller to complete.
	  Consumers request the domain through runtime power management.
```

## sound/soc/realtek/Kconfig
```kconfig
# SPDX-License-Identifier: GPL-2.0-only
config SND_SOC_RTD1296_AIO
	tristate "Realtek RTD1296 analogue microphone capture"
	depends on ARCH_REALTEK || COMPILE_TEST
	depends on OF && HAS_DMA && COMMON_CLK && RESET_CONTROLLER && PM
	help
	  Support the integrated stereo microphone ADC and CPU DMA on RTD1296.
	  The controller provides 48 kHz, 16-bit big-endian capture.
	  Select M to build this driver as a module.
	  The module is called snd-soc-rtd1296-aio.
```
